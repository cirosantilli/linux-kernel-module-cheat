## Config.in
```kconfig
config BR2_PACKAGE_KERNEL_MODULE
	bool "kernel_module"
	help
	  Kernel module hello world.

	  http://example.com/
```

## buildroot_packages/kernel_modules/Config.in
```kconfig
config BR2_PACKAGE_KERNEL_MODULES
	bool "kernel_modules"
	depends on BR2_LINUX_KERNEL
	help
		See README.adoc
```

## buildroot_packages/lkmc_many_files/Config.in
```kconfig
config BR2_PACKAGE_LKMC_MANY_FILES
	bool "lkmc_many_files"
	help
		Create a bunch of files in target/ to benchmark Buildroot.
```

## kernel_module/Config.in
```kconfig
config BR2_PACKAGE_KERNEL_MODULE
	bool "kernel_module"
	depends on BR2_LINUX_KERNEL
	help
		Linux Kernel Module Cheat.
```

## packages/gem5/Config.in
```kconfig
config BR2_PACKAGE_GEM5
	bool "gem5"
	help
	  Only for the m5 guest instrumentation tool of the gem5 system simulator,
	  does not build the simulator itself.

	  http://gem5.org
```

## packages/kernel_modules/Config.in
```kconfig
config BR2_PACKAGE_KERNEL_MODULES
	bool "kernel_modules"
	depends on BR2_LINUX_KERNEL
	help
		Linux Kernel Module Cheat.
```

## packages/lkmc/Config.in
```kconfig
config BR2_PACKAGE_LKMC
	bool "lkmc"
	depends on BR2_LINUX_KERNEL
	help
		Linux Kernel Module Cheat kernel modules and compiled userland examples.
```

## packages/sample_package/Config.in
```kconfig
config BR2_PACKAGE_SAMPLE_PACKAGE
	bool "sample_package"
	help
		Sample Buildroot package.
```

## parsec-benchmark/Config.in
```kconfig
config BR2_PACKAGE_PARSEC_BENCHMARK
	bool "PARSEC_BENCHMARK"
	help
	  Parsec system benchmark.

	  http://parsec.cs.princeton.edu/

if BR2_PACKAGE_PARSEC_BENCHMARK

config BR2_PACKAGE_PARSEC_BENCHMARK_BUILD_LIST
	string "build_list"
	default splash2x
	help
	  Space separated list of parsec packages to build.

config BR2_PACKAGE_PARSEC_BENCHMARK_PARSECMGMT
	bool "parsecmgmt"
	select BR2_PACKAGE_BUSYBOX_SHOW_OTHERS
	select BR2_PACKAGE_BASH
	help
# Needed if you want to run the full parsec benchmark inside the guest.
#
# Parsec shell scripts use a hardcoded /bin/bash
#
# One option would be to try and use /bin/sh.
# But symlinking fails because of BusyBox' symlink mechanism.
# The other option would be to patch Parsec to use /bin/sh and be POSIX compliant.
# But let's take the path of smallest resistance for now.
#
# This is a bit coarse and makes the image larger with useless source code.
#
# But according to du, the source accounts for only 1/5 of the total size,
# so benchmarks dominate, and it doesn't matter much.
#
# Also it is not so critical for simulators anyways unlike real embedded systems.
#
# One possibility to make this better may be to install only the 'inst/' and 'input/'
# folders for each package + toplevel '/bin/' and '/config/', but of course we won't
# know if this works until time consuming testing is done :-)

config BR2_PACKAGE_PARSEC_BENCHMARK_INPUT_SIZE
	string "input_size"
	default test
	help
	  Which input size to generate on the host for the guest.

endif
```
